## layers-agl/meta-agl-devel/meta-oem-extra-libs/conf/layer.conf
```bitbake
# We have a conf and classes directory, add to BBPATH
BBPATH .= ":${LAYERDIR}"

# We have recipes-* directories, add to BBFILES
BBFILES += "${LAYERDIR}/recipes-*/*/*.bb \
	${LAYERDIR}/recipes-*/*/*.bbappend"

BBFILE_COLLECTIONS += "oem-extra-libs"
BBFILE_PATTERN_oem-extra-libs = "^${LAYERDIR}/"
BBFILE_PRIORITY_oem-extra-libs = "7"

# Fixing build errors
SECURITY_CFLAGS_pn-imagemagick = "${SECURITY_NO_PIE_CFLAGS}"
SECURITY_CFLAGS_pn-protobuf = "${SECURITY_NO_PIE_CFLAGS}"
```

## layers-agl/meta-agl/meta-agl-bsp/wic/systemd-joule-bootdisk.wks
```
# short-description: Custom EFI disk image with systemd-boot
# long-description: Creates a partitioned EFI disk image that the user
# can directly dd to boot media. The selected bootloader is systemd-boot
# and we do not have swap.  We assume a Joule system and provide an
# appropriate kernel command line.

part /boot --source bootimg-efi --sourceparams="loader=systemd-boot,initrd=microcode.cpio" --ondisk sda --label msdos --active --align 1024

part / --source rootfs --ondisk sda --fstype=ext4 --label platform --align 1024 --use-uuid

# Modify the append line here as needed to suit the environment
bootloader --ptable gpt --timeout=5 --append="rootwait rootfstype=ext4 console=ttyS2,115200n8 console=tty0 video=efifb maxcpus=4 noxsave reboot=efi kmemleak=off"
```

## layers-agl/meta-agl/meta-agl-distro/conf/distro/poky-agl.conf
```bitbake
require conf/distro/poky.conf

# AGL specific derivations
DISTRO = "poky-agl"
DISTRO_NAME = "Automotive Grade Linux"
DISTRO_VERSION = "5.90.0+snapshot-${DATE}"
#DISTRO_VERSION = "5.90.0"
DISTRO_CODENAME = "flounder"
DISTRO_BRANCH_VERSION_TAG = "flounder/5.90.0"
SDK_VENDOR = "-aglsdk"
SDK_VERSION := "${@'${DISTRO_VERSION}'.replace('snapshot-${DATE}','snapshot')}"

AGL_BRANCH = "master"

#for development
AGL_APP_REVISION = "${AUTOREV}"
AGL_DEFAULT_REVISION = "${AUTOREV}"
#for release
#AGL_APP_REVISION = "refs/tags/${DISTRO_BRANCH_VERSION_TAG}"
#AGL_DEFAULT_REVISION = "refs/tags/${DISTRO_BRANCH_VERSION_TAG}"


MAINTAINER = "AGL <automotive-discussions@lists.linuxfoundation.org>"

TARGET_VENDOR = "-agl"

# Override these in poky based distros
AGL_DEFAULT_DISTRO_FEATURES = "largefile systemd opengl wayland pam bluetooth bluez5"
POKY_DEFAULT_DISTRO_FEATURES := "${AGL_DEFAULT_DISTRO_FEATURES}"
OVERRIDES .= ":${DISTRO_CODENAME}"

QEMU_TARGETS ?= "arm aarch64 i386 x86_64"
# Other QEMU_TARGETS "mips mips64 mips64el ppc sh4"

PREMIRRORS ??= "\
bzr://.*/.*   https://download.automotivelinux.org/AGL/mirror/ \n \
cvs://.*/.*   https://download.automotivelinux.org/AGL/mirror/ \n \
git://.*/.*   https://download.automotivelinux.org/AGL/mirror/ \n \
gitsm://.*/.* https://download.automotivelinux.org/AGL/mirror/ \n \
hg://.*/.*    https://download.automotivelinux.org/AGL/mirror/ \n \
osc://.*/.*   https://download.automotivelinux.org/AGL/mirror/ \n \
p4://.*/.*    https://download.automotivelinux.org/AGL/mirror/ \n \
svn://.*/.*   https://download.automotivelinux.org/AGL/mirror/ \n"

MIRRORS =+ "\
ftp://.*/.*      https://download.automotivelinux.org/AGL/mirror/ \n \
http://.*/.*     https://download.automotivelinux.org/AGL/mirror/ \n \
https://.*/.*    https://download.automotivelinux.org/AGL/mirror/ \n"

# The CONNECTIVITY_CHECK_URI's are used to test whether we can succesfully
# fetch from the network (and warn you if not). To disable the test set
# the variable to be empty.
# Git example url: git://git.yoctoproject.org/yocto-firewall-test;protocol=git;rev=HEAD
CONNECTIVITY_CHECK_URIS ?= ""

PREFERRED_PROVIDER_udev ?= "systemd"
PREFERRED_PROVIDER_udev-utils ?= "systemd"

VIRTUAL-RUNTIME_init_manager = "systemd"
VIRTUAL-RUNTIME_initscripts = ""

# network manager to use (possible values: systemd, connman)
VIRTUAL-RUNTIME_net_manager = "connman" 

DISTRO_FEATURES_APPEND = " "
DISTRO_FEATURES_remove = "x11"
DISTRO_FEATURES_BACKFILL_CONSIDERED = "sysvinit"

PREFERRED_VERSION_wayland-ivi-extension ?= "1.1%"

# Prefer GStreamer 1.10.x by default
PREFERRED_VERSION_gstreamer1.0              ?= "1.10.%"
PREFERRED_VERSION_gstreamer1.0-plugins-bad  ?= "1.10.%"
PREFERRED_VERSION_gstreamer1.0-plugins-base ?= "1.10.%"
PREFERRED_VERSION_gstreamer1.0-plugins-good ?= "1.10.%"
PREFERRED_VERSION_gstreamer1.0-plugins-ugly ?= "1.10.%"
PREFERRED_VERSION_gstreamer1.0-libav        ?= "1.10.%"
PREFERRED_VERSION_gstreamer1.0-omx          ?= "1.2.%"

# Prefer libjpeg-turbo
PREFERRED_PROVIDER_jpeg = "libjpeg-turbo"

# using multiple BSP layers causes dangling bbappends in meta-agl-bsp
# turn it into a warning
#BB_DANGLINGAPPENDS_WARNONLY = "1"

# enforce security-related compiler flags by default
require conf/distro/include/security_flags.inc
# required overrides, upstreamed but not merged yet:
# http://lists.openembedded.org/pipermail/openembedded-devel/2016-June/107727.html
SECURITY_CFLAGS_pn-llvm3.3 = ""
SECURITY_LDFLAGS_remove_pn-llvm3.3 = "-fstack-protector-strong"
SECURITY_STRINGFORMAT_pn-gpm = ""
SECURITY_CFLAGS_pn-libdbus-c++ = ""
SECURITY_LDFLAGS_pn-libdbus-c++ = ""

# more than 2 targets fail to compile these with the SECURITY compiler flags:
# Bug tracked as SPEC-593
SECURITY_CFLAGS_pn-mozjs = ""
SECURITY_LDFLAGS_pn-mozjs = ""
SECURITY_CFLAGS_pn-gpm = ""
SECURITY_LDFLAGS_pn-gpm = ""
SECURITY_CFLAGS_pn-libatasmart = ""
SECURITY_LDFLAGS_pn-libatasmart = ""

# Not yet upstreamed; should be submitted.
SECURITY_CFLAGS_pn-qtwebengine = "${SECURITY_NO_PIE_CFLAGS}"

#Redefined USER_CLASSES
#Disable prelink. It is unmaintained and likely will go away.
#default: USER_CLASSES ?= "buildstats image-mklibs image-prelink"
USER_CLASSES = "buildstats image-mklibs"

# AGL uses 4 optimization levels
# 2 for ARM 32bit 
#   - a high and a medium setting for the CCARGS
#   - the high setting is default (needs >= cortex-a15)
#   - the medium setting is enabled with: DISTRO_FEATURES_append = " agl-medium-arm-compiler "
# 1 for ARM 64bit / AARCH64
# 1 for x86-64
require conf/distro/include/${TARGET_ARCH}-tune.inc

# Generic qemu and qemuboot (runqemu) enhancements
# check qemuboot.bbclass
# - use 2G RAM by default
QB_MEM ?= "-m 2048"
# use pulseaudio on the host side - off as qemu-native is built with alsa
#QB_AUDIO_DRV = "pa"
# expose a virtual 'hda' sound card to the guest (arm/aarch64/x86-64)
QB_AUDIO_OPT = "-soundhw hda"

# Board templates can add extra IMAGE_FSTYPES through this.
# It is added (late) through the AGL image recipes.
AGL_EXTRA_IMAGE_FSTYPES ??= ""
AGL_EXTRA_INITRAMFS_FSTYPES ??= ""
#
# Default IMAGE FSTYPES compressed tarball + ext4.xz
AGL_DEFAULT_IMAGE_FSTYPES ?= "tar.xz ${@bb.utils.contains('DISTRO_FEATURES', 'AGLCI', 'ext4.xz', 'ext4', d)}"
AGL_DEFAULT_INITRAMFS_FSTYPES ?= "ext4.gz"

# DEFAULT IMAGE_FSTYPES for AGL (no - BSPs should not set this)
#
IMAGE_FSTYPES := "${AGL_DEFAULT_IMAGE_FSTYPES} ${AGL_EXTRA_IMAGE_FSTYPES}"
INITRAMFS_FSTYPES := "${AGL_DEFAULT_INITRAMFS_FSTYPES} ${AGL_EXTRA_INITRAMFS_FSTYPES}"
#
# THE FUTURE is 'wic'
# IMAGE_FSTYPES_append = " wic"


# Fix for rpm metadata clash between nativesdk-cmake and nativesdk-qtbase-tools
# (revalidate after 2017-10-15)
DIRFILES_pn-nativesdk-cmake = "1"
```

## layers-agl/meta-agl/meta-agl-profile-apis/conf/layer.conf
```bitbake
# We have a conf and classes directory, add to BBPATH
BBPATH .= ":${LAYERDIR}"

# We have recipes-* directories, add to BBFILES
BBFILES += "${LAYERDIR}/recipes-*/*/*.bb ${LAYERDIR}/recipes-*/*/*.bbappend"

BBFILE_COLLECTIONS += "meta-agl-profile-apis"
BBFILE_PATTERN_meta-agl-profile-apis = "^${LAYERDIR}/"
BBFILE_PRIORITY_meta-agl-profile-apis = "6"

# This should only be incremented on significant changes that will
# cause compatibility issues with other layers
LAYERVERSION_meta-agl-profile-apis = "1"

LAYERDEPENDS_meta-agl-profile-apis = "core"
```

## layers-agl/meta-agl/meta-agl-profile-telematics/conf/layer.conf
```bitbake
# We have a conf and classes directory, add to BBPATH
BBPATH .= ":${LAYERDIR}"

# We have recipes-* directories, add to BBFILES
BBFILES += "${LAYERDIR}/recipes-*/*/*.bb ${LAYERDIR}/recipes-*/*/*.bbappend"

BBFILE_COLLECTIONS += "meta-agl-profile-telematics"
BBFILE_PATTERN_meta-agl-profile-telematics = "^${LAYERDIR}/"
BBFILE_PRIORITY_meta-agl-profile-telematics = "6"

# This should only be incremented on significant changes that will
# cause compatibility issues with other layers
LAYERVERSION_meta-agl-profile-telematics = "1"

LAYERDEPENDS_meta-agl-profile-telematics = "core"
```

## layers-agl/meta-agl/meta-agl-profile-weston-ivi/conf/layer.conf
```bitbake
# We have a conf and classes directory, add to BBPATH
BBPATH .= ":${LAYERDIR}"

# We have recipes-* directories, add to BBFILES
BBFILES += "${LAYERDIR}/recipes-*/*/*.bb ${LAYERDIR}/recipes-*/*/*.bbappend"

BBFILE_COLLECTIONS += "meta-agl-profile-weston-ivi"
BBFILE_PATTERN_meta-agl-profile-weston-ivi = "^${LAYERDIR}/"
BBFILE_PRIORITY_meta-agl-profile-weston-ivi = "6"

# This should only be incremented on significant changes that will
# cause compatibility issues with other layers
LAYERVERSION_meta-agl-profile-weston-ivi = "1"

LAYERDEPENDS_meta-agl-profile-weston-ivi = "core"
```

## layers-agl/meta-agl/meta-agl-profile-weston/conf/layer.conf
```bitbake
# We have a conf and classes directory, add to BBPATH
BBPATH .= ":${LAYERDIR}"

# We have recipes-* directories, add to BBFILES
BBFILES += "${LAYERDIR}/recipes-*/*/*.bb ${LAYERDIR}/recipes-*/*/*.bbappend"

BBFILE_COLLECTIONS += "meta-agl-profile-weston"
BBFILE_PATTERN_meta-agl-profile-weston = "^${LAYERDIR}/"
BBFILE_PRIORITY_meta-agl-profile-weston = "6"

# This should only be incremented on significant changes that will
# cause compatibility issues with other layers
LAYERVERSION_meta-agl-profile-weston = "1"

LAYERDEPENDS_meta-agl-profile-weston = "core"
```

## layers-agl/meta-agl/meta-agl-profile-world/conf/layer.conf
```bitbake
# We have a conf and classes directory, add to BBPATH
BBPATH .= ":${LAYERDIR}"

# We have recipes-* directories, add to BBFILES
BBFILES += "${LAYERDIR}/recipes-*/*/*.bb ${LAYERDIR}/recipes-*/*/*.bbappend"

BBFILE_COLLECTIONS += "meta-agl-profile-world"
BBFILE_PATTERN_meta-agl-profile-world = "^${LAYERDIR}/"
BBFILE_PRIORITY_meta-agl-profile-world = "6"

# This should only be incremented on significant changes that will
# cause compatibility issues with other layers
LAYERVERSION_meta-agl-profile-world = "1"

LAYERDEPENDS_meta-agl-profile-world = "core"
```

## layers-agl/meta-agl/meta-agl-upstream-extensions/conf/layer.conf
```bitbake
# We have a conf and classes directory, add to BBPATH
BBPATH .= ":${LAYERDIR}"

# We have recipes-* directories, add to BBFILES
BBFILES += "${LAYERDIR}/recipes-*/*/*.bb ${LAYERDIR}/recipes-*/*/*.bbappend"

BBFILE_COLLECTIONS += "meta-agl-upstream-extensions"
BBFILE_PATTERN_meta-agl-upstream-extensions = "^${LAYERDIR}/"
BBFILE_PRIORITY_meta-agl-upstream-extensions = "6"

# This should only be incremented on significant changes that will
# cause compatibility issues with other layers
LAYERVERSION_meta-agl-upstream-extensions = "1"

LAYERDEPENDS_meta-agl-upstream-extensions = "core"
```

## layers-local/meta-localdev/conf/layer.conf
```bitbake
# We have a conf and classes directory, add to BBPATH
BBPATH .= ":${LAYERDIR}"

# We have recipes-* directories, add to BBFILES
BBFILES += "${LAYERDIR}/recipes-*/*/*.bb ${LAYERDIR}/recipes-*/*/*.bbappend"

BBFILE_COLLECTIONS += "meta-localdev"
BBFILE_PATTERN_meta-localdev = "^${LAYERDIR}/"
BBFILE_PRIORITY_meta-localdev = "99"

# This should only be incremented on significant changes that will
# cause compatibility issues with other layers
LAYERVERSION_meta-localdev = "1"

LAYERDEPENDS_meta-localdev = "core"
```
